## hw/arc/Kconfig
```kconfig
config ARC_VIRT
    bool
    default y
    depends on ARC32 || ARC64
    select SERIAL_MM
    select VIRTIO_MMIO
    select PCI_EXPRESS_GENERIC_BRIDGE
    select PCI_DEVICES

config ARC
    bool
```

## hw/c6x/Kconfig
```kconfig
config C6X_DSK6455
    bool
    default y
    depends on C6X && FDT
    select SERIAL_MM
    select PTIMER
    select DEVICE_TREE
```

## hw/cris/Kconfig
```kconfig
config ETRAX100LX
    bool
    default y
    depends on CRIS

config AXIS
    bool
    default y
    depends on CRIS
    select ETRAXFS
    select PFLASH_CFI02
    select VIRTIO_MMIO

config ETRAXFS
   bool
   select PTIMER
```

## hw/csky/Kconfig
```kconfig
config CSKY_VIRT
    bool
    default y
    depends on CSKYV2 && FDT
    select DEVICE_TREE
    select CSKY_MIC
    select CSKY_MPTIMER
    select CSKY_UART
    select CSKY_EXIT
    select VIRTIO_MMIO
```

## hw/frv/Kconfig
```kconfig
config FRV_MB93091
    bool
    default y
    depends on FRV
    select SERIAL_MM
    select PTIMER
    select UNIMP
```

## hw/h8300/Kconfig
```kconfig
config H83069
    bool
    select RENESAS_TMR
    select RENESAS_TMR16
    select RENESAS_SCI
    select H8300H_INTC

config H8S2674
    bool
    select RENESAS_TMR
    select RENESAS_TPU
    select RENESAS_SCI
    select H8S_INTC

config H8300_KANEBEBE
    bool
    default y
    depends on H8300 && FDT
    select DEVICE_TREE
    select H83069
    select NE2000_LOCAL

config H8300_EDOSK2674
    bool
    default y
    depends on H8300 && FDT
    select DEVICE_TREE
    select H8S2674
    select PFLASH_CFI01
    select SMC91C111
```

## hw/ia64/Kconfig
```kconfig
config IA64_VIRT
    bool
    default y
    depends on IA64
    select SERIAL_ISA
    select ISA_BUS
    select VIRTIO_MMIO
    select ACPI
    select PCI
    select PCI_EXPRESS_GENERIC_BRIDGE
    imply PCI_DEVICES
    imply LSI_SCSI_PCI
    imply VGA_PCI
    imply ISA_DEBUG
    imply IDE_CMD646
```

## hw/kvx/Kconfig
```kconfig
config MPPA_CLUSTER
    bool
    default y
    depends on KVX && FDT
    select DEVICE_TREE
    select SERIAL_MM
    select CPU_CLUSTER
```

## hw/lm32/Kconfig
```kconfig
config LM32_DEVICES
    bool
    select PTIMER

config MILKYMIST
    bool
    default y
    depends on LM32
    select LM32_DEVICES
    select UNIMP
```

## hw/m68k/Kconfig
```kconfig
config AN5206
    bool
    default y
    depends on M68K
    select COLDFIRE
    select PTIMER

config MCF5208
    bool
    default y
    depends on M68K
    select COLDFIRE
    select PTIMER
    select VIRTIO_MMIO

config NEXTCUBE
    bool
    default y
    depends on M68K
    select FRAMEBUFFER
    select ESCC
    select EMPTY_SLOT

config Q800
    bool
    default y
    depends on M68K
    select MAC_VIA
    select NUBUS
    select MACFB
    select SWIM
    select ESCC
    select ESP
    select DP8393X
    select OR_IRQ
    select DJMEMC
    select IOSB
    select ASC

config MACII
    bool
    default y
    depends on M68K
    select MAC_VIA
    select NUBUS
    select MACFB
    select SWIM
    select ESCC
    select OR_IRQ
    select ASC
    select NCR5380
    select NUBUS_8390

config M68K_VIRT
    bool
    default y
    depends on M68K
    select M68K_IRQC
    select VIRT_CTRL
    select GOLDFISH_PIC
    select GOLDFISH_TTY
    select GOLDFISH_RTC
    select VIRTIO_MMIO

config M68328
    bool
    default y
    depends on M68K
    select SERIAL_MM
```

## hw/meta/Kconfig
```kconfig
config META_01SP
    bool
    default y
    depends on META
    select PTIMER
    select UNIMP
    select DEVICE_TREE
```

## hw/nds32/Kconfig
```kconfig
config NDS32_AE3XX
    bool
    default y
    depends on NDS32 && FDT
    select SERIAL_MM
    select PTIMER
    select DEVICE_TREE

config NDS32_AG101P
    bool
    default y
    depends on NDS32
    select SERIAL_MM
    select UNIMP
```

## target/Kconfig
```kconfig
source alpha/Kconfig
source arc/Kconfig
source arm/Kconfig
source avr/Kconfig
source cris/Kconfig
source csky/Kconfig
source h8300/Kconfig
source hppa/Kconfig
source i386/Kconfig
source loongarch/Kconfig
source m68k/Kconfig
source meta/Kconfig
source microblaze/Kconfig
source mips/Kconfig
source nds32/Kconfig
source nios2/Kconfig
source or1k/Kconfig
source ppc/Kconfig
source riscv/Kconfig
source rx/Kconfig
source s390x/Kconfig
source sh4/Kconfig
source sparc/Kconfig
source tilegx/Kconfig
source tricore/Kconfig
source xtensa/Kconfig
source hexagon/Kconfig
source kvx/Kconfig
source lm32/Kconfig
source avr32/Kconfig
source bfin/Kconfig

config TARGET_BIG_ENDIAN
    bool
```
